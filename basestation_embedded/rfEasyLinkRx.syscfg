// These arguments were used when this file was generated. They will be automatically applied on subsequent loads 
// via the GUI or CLI invocations. Run CLI with '--help' for additional information on how to override these arguments.
// @cliArgs --board "/ti/boards/CC1352P_2_LAUNCHXL" --product "simplelink_cc13x2_26x2_sdk@3.40.00.02"
// @versions {"data":"2019083011","timestamp":"2019083011","tool":"1.2.952","templates":"2019083011"}

var RF = scripting.addModule("/ti/drivers/RF");
var Power = scripting.addModule("/ti/drivers/Power");
var CCFG = scripting.addModule("/ti/devices/CCFG");
var Board = scripting.addModule("/ti/drivers/Board");
var DriverLib = scripting.addModule("/ti/devices/DriverLib");
var GPIO = scripting.addModule("/ti/drivers/GPIO");
var GPIO1 = GPIO.addInstance();
var GPIO2 = GPIO.addInstance();
var easylink = scripting.addModule("/ti/easylink/easylink");
var multi_stack_validate = scripting.addModule("/ti/easylink/multi_stack_validate");
var PWM = scripting.addModule("/ti/drivers/PWM");
var PWM1 = PWM.addInstance();
var UART = scripting.addModule("/ti/drivers/UART");
var UART1 = UART.addInstance();
var GPIO3 = GPIO.addInstance();
var GPIO4 = GPIO.addInstance();
var GPIO5 = GPIO.addInstance();
var GPIO6 = GPIO.addInstance();
var GPIO7 = GPIO.addInstance();
// Use Hardware - Select the hardware to use, or 'None' to use available header pins
RF.$hardware = system.deviceData.board.components["SKY13317-373LF"];
// Enable XOSC Cap array modification - Enable modification (delta) to XOSC cap-array
CCFG.xoscCapArray = true;
// XOSC Cap Array Delta - Modify the high frequency oscillator cap-array, changing the frequency offset
CCFG.xoscCapArrayDelta = 0xC1;
// Enable Bootloader - Enable ROM Bootloader, for flashing from external host
CCFG.enableBootloader = true;
// Enable Bootloader Backdoor - When enabling the Bootloader Backdoor, the Bootloader can be activated externally by pulling a pin, even when a valid flash image is present. Note, enabling the backdoor allows an external host to read back a flash image from the device
CCFG.enableBootloaderBackdoor = true;
// Bootloader Backdoor DIO - DIO (pin) to trigger Bootloader backdoor, this pin is only needed at boot
CCFG.dioBootloaderBackdoor = 15;
// Trigger Level of Bootloader Backdoor - Active high or low on selected DIO to open boot loader backdoor
CCFG.levelBootloaderBackdoor = "Active low";
// Force VDDR - Necessary for external load mode, or for maximum PA output power
CCFG.forceVddr = true;
// Name
CCFG.ccfgTemplate.$name = "ti_devices_CCFGTemplate0";
// Use Hardware - Select the hardware to use, or 'None' to use available header pins
GPIO1.$hardware = system.deviceData.board.components.LED_RED;
// Name - The C/C++ identifier used in applications as the index parameter passed to GPIO runtime APIs
GPIO1.$name = "CONFIG_GPIO_RLED";
// Name
GPIO1.pinInstance.$name = "CONFIG_PIN_RLED";
// Use Hardware - Select the hardware to use, or 'None' to use available header pins
GPIO2.$hardware = system.deviceData.board.components.LED_GREEN;
// Name - The C/C++ identifier used in applications as the index parameter passed to GPIO runtime APIs
GPIO2.$name = "CONFIG_GPIO_GLED";
// Name
GPIO2.pinInstance.$name = "CONFIG_PIN_GLED";
// Address Size (bytes) - Defines the address size used for all Tx/Rx operations
easylink.addrSize = 0;
// PHY Type - Selects the PHY/setting
easylink.radioConfigEasylinkPhyCustom.phyType868 = "slr5kbps2gfsk";
// Name
easylink.radioConfigEasylinkPhyCustom.codeExportConfig.$name = "ti_radioconfig_code_export_param0";
// PA table Export Method - Select how PA table is to be exported
easylink.radioConfigEasylinkPhyCustom.codeExportConfig.paExport = "combined";
// Name - The C/C++ identifier used in applications as the index parameter passed to PWM runtime APIs
PWM1.$name = "PROPORTIONAL_VALVE";
// Name - The C/C++ identifier used in applications as the index parameter passed to GPTimerCC26XX runtime APIs
PWM1.timerObject.$name = "CONFIG_GPTIMER_0";
// Name
PWM1.timerObject.timer.$name = "MyGPTM1";
// Assign pin
PWM1.timerObject.timer.pwmPin.$assign = "boosterpack.23"; // DIO25
// Name
PWM1.timerObject.pwmPinInstance.$name = "CONFIG_PIN_0";
// Name - The C/C++ identifier used in applications as the index parameter passed to UART runtime APIs
UART1.$name = "CONFIG_UART_0";
// Use Hardware - Select the hardware to use, or 'None' to use available header pins
UART1.$hardware = system.deviceData.board.components.XDS110UART;
// Name
UART1.txPinInstance.$name = "CONFIG_PIN_1";
// Output State - Initial Output State
UART1.txPinInstance.outputState = "High";
// Name
UART1.rxPinInstance.$name = "CONFIG_PIN_2";
// Pull - Pull up/down
UART1.rxPinInstance.pull = "None";
// Name
UART1.uart.$name = "MyUART1";
// Use Peripheral
UART1.uart.$assign = "UART0";
// Name - The C/C++ identifier used in applications as the index parameter passed to GPIO runtime APIs
GPIO3.$name = "PANEL_LED";
// Mode - Select the GPIO mode
GPIO3.mode = "Output";
// Assign pin
GPIO3.gpioPin.$assign = "boosterpack.24"; // DIO26
// Name
GPIO3.pinInstance.$name = "CONFIG_PIN_3";
// Mode - Select the GPIO mode
GPIO4.mode = "Output";
// Name - The C/C++ identifier used in applications as the index parameter passed to GPIO runtime APIs
GPIO4.$name = "MAIN_DRAIN_VALVE";
// Assign pin
GPIO4.gpioPin.$assign = "boosterpack.9"; // DIO21
// Name
GPIO4.pinInstance.$name = "CONFIG_PIN_4";
// Name - The C/C++ identifier used in applications as the index parameter passed to GPIO runtime APIs
GPIO5.$name = "MAIN_INPUT_VALVE";
// Mode - Select the GPIO mode
GPIO5.mode = "Output";
// Assign pin
GPIO5.gpioPin.$assign = "boosterpack.19"; // DIO19
// Name
GPIO5.pinInstance.$name = "CONFIG_PIN_5";
// Name - The C/C++ identifier used in applications as the index parameter passed to GPIO runtime APIs
GPIO6.$name = "BRAKE_INPUT_VALVE";
// Mode - Select the GPIO mode
GPIO6.mode = "Output";
// Assign pin
GPIO6.gpioPin.$assign = "boosterpack.10"; // DIO5
// Name
GPIO6.pinInstance.$name = "CONFIG_PIN_6";
// Name - The C/C++ identifier used in applications as the index parameter passed to GPIO runtime APIs
GPIO7.$name = "BRAKE_EMERG_VALVE";
// Mode - Select the GPIO mode
GPIO7.mode = "Output";
// Assign pin
GPIO7.gpioPin.$assign = "boosterpack.18"; // DIO11
// Name
GPIO7.pinInstance.$name = "CONFIG_PIN_7";
// Suggest solution
RF.rfAntennaPin0.$suggestSolution = "43";
// Suggest solution
RF.rfAntennaPin1.$suggestSolution = "42";
// Suggest solution
RF.rfAntennaPin2.$suggestSolution = "41";
// Suggest solution
GPIO1.gpioPin.$suggestSolution = "11";
// Suggest solution
GPIO2.gpioPin.$suggestSolution = "12";
// Suggest solution
PWM1.timerObject.timer.$suggestSolution = "GPTM0";
// Suggest solution
UART1.uart.txPin.$suggestSolution = "19";
// Suggest solution
UART1.uart.rxPin.$suggestSolution = "18";
